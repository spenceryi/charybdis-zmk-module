#include <behaviors.dtsi>
#include <dt-bindings/zmk/keys.h>
#include <dt-bindings/zmk/bt.h>
#include <dt-bindings/zmk/mouse.h>
#include <input/processors.dtsi>
#include <dt-bindings/zmk/input_transform.h>

#define U_TAPPING_TERM 200

/* Layers */
#define DEF 0
#define QWERTY 1
#define SYM 2
#define NAV 3
#define NUM 4
#define FN 5
#define SYS 6
#define SNIPE 7
#define SCROLL 8

#define XXX &none
#define ___ &trans

#define QUICK_TAP_MS 175
#define TAB_LEFT &kp LC(LS(TAB))
#define TAB_RIGHT &kp LC(TAB)
#define SWITCH_LANG &kp LC(SPACE)
#define UNDO &kp LC(Z)

#define MT_CORE \
    flavor = "tap-preferred"; \
    tapping-term-ms = <220>; \
    quick-tap-ms = <220>; \
    hold-trigger-key-positions = <0>;

&sk {
    release-after-ms = <800>;
    quick-release;            
};

&lt {
    flavor = "tap-preferred";
    tapping-term-ms = <200>;
    quick-tap-ms = <QUICK_TAP_MS>;
};

&mt { MT_CORE };
#define NAV_UP &mt LC(HOME) UP
#define NAV_DOWN  &mt LC(END)  DOWN
#define NAV_LEFT  &mt_home 0   LEFT 
#define NAV_RIGHT &mt_end  0   RIGHT

&caps_word {  // mods deactivate caps-word, requires PR #1451
    /delete-property/ ignore-modifiers;
};

/ {
    trackball_listener {
        compatible = "zmk,input-listener";
        device = <&trackball_split>;

        snipe {
            layers = <SNIPE>;
            input-processors = <&zip_xy_scaler 1 3>;
        };

        scroll {
            layers = <SCROLL>;
            input-processors = <&zip_xy_to_scroll_mapper>, <&zip_scroll_scaler 1 9>, <&zip_scroll_transform (INPUT_TRANSFORM_Y_INVERT)>;
        };
    };

    behaviors {
        hm: homerow_mods {
            compatible = "zmk,behavior-hold-tap";
            #binding-cells = <2>;
            flavor = "tap-preferred";
            tapping-term-ms = <240>;
            quick-tap-ms = <150>;
            bindings =
                <&kp>,
                <&kp>;
        };

        comma_morph: comma_morph {
            compatible = "zmk,behavior-mod-morph";
            #binding-cells = <0>;
            bindings = <&kp COMMA>, <&kp SEMI>;
            mods = <(MOD_LSFT|MOD_RSFT)>;
        };

        dot_morph: dot_morph {
            compatible = "zmk,behavior-mod-morph";
            #binding-cells = <0>;
            bindings = <&kp DOT>, <&kp COLON>;
            mods = <(MOD_LSFT|MOD_RSFT)>;
        };

        qexcl: qexcl {
            compatible = "zmk,behavior-mod-morph";
            #binding-cells = <0>;
            bindings = <&kp QMARK>, <&kp EXCL>;
            mods = <(MOD_LSFT|MOD_RSFT)>;
        };

        smart_shift: smart_shift {
            compatible = "zmk,behavior-mod-morph";
            #binding-cells = <0>;
            bindings = <&sk LSHFT>, <&caps_word>;
            mods = <(MOD_LSFT)>;
        };

        mt_home: mt_home {
            compatible = "zmk,behavior-hold-tap";
            #binding-cells = <2>;
            bindings = <&masked_home>, <&kp>;
            MT_CORE
        };

        mt_end: mt_end {
            compatible = "zmk,behavior-hold-tap";
            #binding-cells = <2>;
            bindings = <&masked_end>, <&kp>;
            MT_CORE
        };

        masked_home: masked_home {
            compatible = "zmk,behavior-mod-morph";
            #binding-cells = <0>;
            bindings = <&kp HOME>, <&kp HOME>;
            mods = <(MOD_LCTL)>; 
        };

        masked_end: masked_end {
            compatible = "zmk,behavior-mod-morph";
            #binding-cells = <0>;
            bindings = <&kp END>, <&kp END>;
            mods = <(MOD_LCTL)>; 
        };
    };

    conditional_layers {
        compatible = "zmk,conditional-layers";
        tri_layer {
            if-layers = <NUM SYM>;
            then-layer = <FN>;
        };  
    };

    keymap {
        compatible = "zmk,keymap";

        BASE {
            bindings = <
&kp W             &kp L             &kp Y          &kp P               &kp B               &kp Z          &kp F               &kp O          &kp U              &kp SQT
&hm LSHFT C       &hm LCTRL R       &hm LALT S     &hm LGUI T          &kp G               &kp M          &hm LGUI N          &hm RALT E     &hm RCTRL I        &hm RSHFT A
&kp Q             &kp J             &kp V          &kp D               &kp K               &kp X          &kp H               &comma_morph   &dot_morph         &qexcl
                                    XXX            &lt NAV SPACE       &mo NUM             &mo SYM        &smart_shift
            >; 
        };

        QWERTY {
            bindings = <
&kp Q             &kp W             &kp E          &kp R               &kp T               &kp Y          &kp U               &kp I          &kp O              &kp P
&kp A             &kp S             &kp D          &kp F               &kp G               &kp H          &kp J               &kp K          &kp L              &kp SEMI
&kp Z             &kp X             &kp C          &kp V               &kp B               &kp N          &kp M               ___            ___                ___
                                    ___            ___                 ___                 ___            ___
            >;            
        };

        SYM {
            bindings = <
XXX               &kp LBKT          &kp LBRC        &kp LPAR           &kp LT              &kp GT        &kp RPAR            &kp RBRC          &kp RBKT        &kp GRAVE
&kp MINUS         &kp STAR          &kp EQUAL       &kp UNDER          &kp DLLR            &kp HASH      &kp LGUI            &kp RALT          &kp RCTRL       &kp RSHFT
&kp PLUS          &kp PIPE          &kp AT          &kp FSLH           &kp PRCNT           &kp SQT       &kp BSLH            &kp AMPS          &kp CARET       &kp TILDE
                                    ___             ___                ___                 ___           ___
            >;            
        };

        NAV {
            bindings = <
XXX               XXX               XXX             &kp TAB            &kp C_VOL_UP        &kp PG_UP     &kp BSPC            NAV_UP            &kp DEL         &kp ESC
&kp LSHFT         &kp LCTRL         &kp LALT        &kp LGUI           &kp C_VOL_DN        &kp PG_DN     NAV_LEFT            NAV_DOWN          NAV_RIGHT       &kp RET
&mo SNIPE         &mo SCROLL        &mkp RCLK       &mkp LCLK          &kp C_MUTE          UNDO          XXX                 XXX               XXX             XXX
                                    ___             ___                ___                 ___           ___
            >;            
        };

        NUM {
            bindings = <
XXX               XXX               XXX             XXX                XXX                 &kp STAR      &kp N7              &kp N8            &kp N9          &kp FSLH
XXX               XXX               XXX             XXX                XXX                 &dot_morph    &kp N4              &kp N5            &kp N6          &kp EQUAL
XXX               XXX               XXX             XXX                XXX                 &kp PLUS      &kp N1              &kp N2            &kp N3          &kp MINUS
                                    ___             ___                ___                 ___           &kp N0
            >;            
        };

        FN {
            bindings = <
&kp F1            &kp F2            &kp F3          &kp F4             &kp F5              &kp F6        &kp F7              &kp F8            &kp F9          &kp F10
&kp LSHFT         &kp LCTRL         &kp LALT        &kp LGUI           &kp F11             &kp F12       &kp LGUI            &kp LALT          &kp LCTRL       &kp RSHFT
XXX               XXX               XXX             XXX                XXX                 XXX           SWITCH_LANG         &tog QWERTY       XXX             &mo SYS
                                    ___             ___                ___                 ___           ___
            >;            
        };

        SYS {
            bindings = <
&bt BT_SEL 0      &bt BT_SEL 1      &bt BT_SEL 2    &bt BT_SEL 3       &bt BT_CLR          XXX           XXX                 XXX               XXX             XXX
XXX               XXX               XXX             XXX                &bootloader         &bootloader   XXX                 XXX               XXX             XXX
XXX               XXX               XXX             XXX                &sys_reset          &sys_reset    XXX                 XXX               XXX             XXX
                                    ___             ___                ___                 ___           ___
            >;            
        };

        SNIPE {
            bindings = <
XXX               XXX               XXX             XXX                XXX                 XXX           XXX                 XXX               XXX             XXX
&kp LSHFT         &kp LCTRL         &kp LALT        &kp LGUI           XXX                 XXX           &kp LGUI            &kp LALT          &kp LCTRL       &kp RSHFT
XXX               &mo SCROLL        &mkp RCLK       &mkp LCLK          XXX                 XXX           XXX                 XXX               XXX             XXX
                                    ___             ___                ___                 ___           ___
            >;            
        };

        SCROLL {
            bindings = <
XXX               XXX               XXX             XXX                XXX                 XXX           XXX                 XXX               XXX             XXX
&kp LSHFT         &kp LCTRL         &kp LALT        &kp LGUI           XXX                 XXX           &kp LGUI            &kp LALT          &kp LCTRL       &kp RSHFT
XXX               XXX               XXX             XXX                XXX                 XXX           XXX                 XXX               XXX             XXX
                                    ___             ___                ___                 ___           ___
            >;
        };
    };
};
